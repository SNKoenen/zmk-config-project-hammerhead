## config/boards/shields/project_hammerhead/Kconfig.defconfig
```kconfig
if SHIELD_PROJECT_HAMMERHEAD_LEFT

config ZMK_BLE
	default y

config ZMK_USB
	default y

config ZMK_KEYBOARD_NAME
    default "prjct_hammerhead"

config ZMK_SPLIT_ROLE_CENTRAL
    default y

endif

if SHIELD_PROJECT_HAMMERHEAD_LEFT || SHIELD_PROJECT_HAMMERHEAD_RIGHT

config ZMK_SPLIT
    default y

endif
```

## config/boards/shields/project_hammerhead/Kconfig.shield
```kconfig
config SHIELD_PROJECT_HAMMERHEAD_LEFT
    def_bool $(shields_list_contains,project_hammerhead_left)

config SHIELD_PROJECT_HAMMERHEAD_RIGHT
    def_bool $(shields_list_contains,project_hammerhead_right)
```
